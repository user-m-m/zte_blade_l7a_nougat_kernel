## drivers/input/misc/mir3da/Kconfig
```kconfig
config INPUT_MIR3DA_I2C
	tristate "MIR3DA accelerometer device with I2C bus"
	depends on I2C
	default n
	help
	  Say Y here if you have a Miramems's device on the board and use I2C
	  communication, else say N.
      
	  To compile this driver as a module, choose M here.
```
