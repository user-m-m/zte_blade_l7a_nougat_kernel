/*
* Copyright (C) 2013 Spreadtrum Communication Incorporated
*		http://www.spreadtrum.com/
*
* This program is free software; you can redistribute it and/or modify
* it under the terms of the GNU General Public License version 2 as
* published by the Free Software Foundation.
*/

/* This is the sprd battery default DTS */

/ {
	sprd_battery: sprd_battery {
		compatible = "sprd,sprd-battery";
		gpios = <&a_eic_gpio 0 0        /* chg int */
			&a_eic_gpio 4 0        /* cv state */
			&a_eic_gpio 6 0      /* chg ovi */
			&a_eic_gpio 9 0>;	/* battery detect */
		chg-end-vol-h = <4365>;
		chg-end-vol-pure = <4360>;
		chg-end-vol-l = <4340>;
		chg-bat-safety-vol = <4430>;
		rechg-vol = <4200>;
		adp-cdp-cur = <700>;
		adp-dcp-cur = <789>;
		adp-sdp-cur = <550>;
		ovp-stop = <6500>;
		ovp-restart = <5800>;
		chg-timeout = <21600>;
		chgtimeout-show-full = <0>;
		chg-rechg-timeout = <5400>;
		chg-cv-timeout = <3600>;
		chg-eoc-level = <3>;
		cccv-default = <0>;
		chg-end-cur = <120>;
		otp-high-stop = <1450>;
		otp-high-restart = <1420>;
		otp-low-stop = <1000>;
		otp-low-restart = <1030>;
		chg-polling-time = <10>;
		chg-polling-time-fast = <1>;
		bat-polling-time = <15>;
		bat-polling-time-fast = <15>;
		cap-one-per-time = <30>;
		cap-valid-range-poweron = <0>;
		chg-full-condition = <0>;	/*0 vol and cur,1 status and cur(need add),2 ext ic*/
		temp-support = <1>;
		temp-adc-ch = <0>;
		temp-adc-scale = <0>;
		temp-adc-sample-cnt = <15>;
		temp-table-mode = <1>;
		temp-comp-res = <30>;	/*30mohm,if temp-table-mode = <1>, use it*/
		temp-tab-size = <19>;
		temp-tab-val = <655802 483953 360849 271697 206463 158214 122259 95226 74730 59064 47000 37643 30333 24590 20047 16432 13538 11209 9327>;
		temp-tab-temp = <750 800 850 900 950 1000 1050 1100 1150 1200 1250 1300 1350 1400 1450 1500 1550 1600 1650>;	/* temperature + 1000,750 = 1000 + (-250)*/
		jeita-tab-size = <6>;
		jeita-temp-tab = <1030 1100 1200 1300 1450 3000>;
		jeita-temp-recovery-tab = <1000 1070 1170 1270 1420 3000>;
		jeita-cur-tab = <0 550 950 950 950 0>;
		jeita-cccv-tab = <4200 4360 4360 4360 4360 4360>;
		fgu-mode = <0>;
		alm-soc = <5>;
		alm-vol = <3600>;
		soft-vbat-uvlo = <3100>;
		rint = <246>;
		cnom = <2140>;
		rsense-real = <204>;
		rsense-spec = <200>;
		relax-current = <50>;
		fgu-cal-ajust = <0>;
		ocv-type = <1>;		//0 for soft_ocv,1 for pocv
		ocv-tab-size = <21>;
		ocv-tab-vol = <4320 4267 4220 4161 4111 4070 4000 3962 3922 3873 3844 3822 3800 3785 3773 3760 3746 3718 3689 3675 3400>;
		ocv-tab-cap = <100  95   90   85   80   75   70   65   60   55   50   45   40   35   30   25   20   15   10   5    0>;
		cnom-temp-tab = <1050 2142	/*value = 1000 + temp*/
				1025 2139
				1000 1816
				990  818>;
		rint-temp-tab = <1050 150	/*value = 1000 + temp*/
				1025 246
				1000 768
				990  1463>;
		sprd_chg: sprd_chg{
			compatible  = "sprd,sprd_chg";
			interrupt-parent = <&gic>;
			interrupts = <0 120 0x0>;
		};
		sprd_fgu: sprd_fgu{
			compatible  = "sprd,sprd_fgu";
			interrupt-parent = <&adi>;
			interrupts = <4 0x0>;
		};
	};
};
