/*
* Copyright (C) 2013 Spreadtrum Communication Incorporated
*		http://www.spreadtrum.com/
*
* This program is free software; you can redistribute it and/or modify
* it under the terms of the GNU General Public License version 2 as
* published by the Free Software Foundation.
*/

 

/ {
	sprd_battery: sprd_battery {
		compatible = "sprd,sprd-battery";
		gpios = <&a_eic_gpio 0 0         
			&a_eic_gpio 4 0         
			&a_eic_gpio 6 0       
			&a_eic_gpio 9 0>;	 
		chg-end-vol-h = <4365>;
		chg-end-vol-pure = <4360>;
		chg-end-vol-l = <4336>;
		chg-bat-safety-vol = <4430>;
		rechg-vol = <4200>;
		adp-cdp-cur = <700>;
		adp-dcp-cur = <789>;
		adp-sdp-cur = <550>;
		ovp-stop = <6500>;
		ovp-restart = <5800>;
		chg-timeout = <21600>;
		chgtimeout-show-full = <0>;
		chg-rechg-timeout = <5400>;
		chg-cv-timeout = <3600>;
		chg-eoc-level = <3>;
		cccv-default = <0>;
		chg-end-cur = <110>;
		otp-high-stop = <1600>;
		otp-high-restart = <1570>;
		otp-low-stop = <1000>;
		otp-low-restart = <1030>;
		chg-polling-time = <10>;
		chg-polling-time-fast = <1>;
		bat-polling-time = <15>;
		bat-polling-time-fast = <15>;
		cap-one-per-time = <30>;
		cap-valid-range-poweron = <0>;
		chg-full-condition = <0>;	 
		temp-support = <1>;
		temp-adc-ch = <0>;
		temp-adc-scale = <0>;
		temp-adc-sample-cnt = <15>;
		temp-table-mode = <1>;
		temp-comp-res = <30>;	 
		temp-tab-size = <19>;
		temp-tab-val = <655802 483953 360849 271697 206463 158214 122259 95226 74730 59064 47000 37643 30333 24590 20047 16432 13538 11209 9327>;
		temp-tab-temp = <750 800 850 900 950 1000 1050 1100 1150 1200 1250 1300 1350 1400 1450 1500 1550 1600 1650>;	 
		jeita-tab-size = <6>;
		jeita-temp-tab = <1000 1150 1250 1450 1600 3000>;
		jeita-temp-recovery-tab = <1000 1070 1170 1420 1570 3000>;
		jeita-cur-tab = <0 550 789 789 789 0>;
		jeita-cccv-tab = <4200 4360 4360 4360 4100 4100>;
		fgu-mode = <0>;
		alm-soc = <5>;
		alm-vol = <3600>;
		soft-vbat-uvlo = <3100>;
		rint = <232>;
		cnom = <2160>;
		rsense-real = <204>;
		rsense-spec = <200>;
		relax-current = <50>;
		fgu-cal-ajust = <0>;
		ocv-type = <1>;		 
		ocv-tab-size = <21>;
		ocv-tab-vol = <4324 4261 4205 4152 4101 4063 3992 3965 3922 3874 3844 3822 3804 3790 3775 3754 3734 3717 3690 3668 3400>;
		ocv-tab-cap = <100  95   90   85   80   75   70   65   60   55   50   45   40   35   30   25   20   15   10   5    0>;
		cnom-temp-tab = <1050 2142	 
				1025 2139
				1000 1816
				990  818>;
		rint-temp-tab = <1050 150	 
				1025 232
				1000 768
				990  1463>;
		sprd_chg: sprd_chg{
			compatible  = "sprd,sprd_chg";
			interrupt-parent = <&gic>;
			interrupts = <0 120 0x0>;
		};
		sprd_fgu: sprd_fgu{
			compatible  = "sprd,sprd_fgu";
			interrupt-parent = <&adi>;
			interrupts = <4 0x0>;
		};
	};
};
